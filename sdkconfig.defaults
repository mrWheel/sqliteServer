## sdkconfig.defaults
```kconfig
# PSRAM
CONFIG_SPIRAM=y
CONFIG_SPIRAM_BOOT_INIT=y
CONFIG_SPIRAM_MODE_OCT=y
CONFIG_SPIRAM_SPEED_80M=y
# Als 80M instabiel is, zet bovenstaande regel uit en gebruik:
# CONFIG_SPIRAM_SPEED_40M=y
```
